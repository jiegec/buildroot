## package/pth_hello/Config.in
```kconfig
config BR2_PACKAGE_PTH_HELLO
    bool "pth_hello"
    help
        pth_hello package.
```

## package/thread_sum/Config.in
```kconfig
config BR2_PACKAGE_THREAD_SUM
    bool "thread_sum"
    help
        thread_sum package.
```
